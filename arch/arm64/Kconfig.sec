## arch/arm64/Kconfig.sec
```kconfig
menu "Product"

config SEC_A6PLTE_PROJECT
	depends on ARCH_SDM450
	default n
	bool "Samsung A6-Plus LTE Project"
	help
	  Support for Samsung A6-Plus LTE Project

config MACH_A6PLTE_EUR_OPEN
	depends on SEC_A6PLTE_PROJECT
	default n
	bool "Samsung A6-Plus LTE EUR OPEN"
	help
	  Support for Samsung A6-Plus LTE EUR OPEN device.

endmenu
```

## drivers/motor/Kconfig
```kconfig
config MSM_VIBRATOR
	tristate "MSM_VIBRATOR"
	default n
	help
	  Say Y to enable MSM_VIBRATOR support
```

## drivers/muic/Kconfig
```kconfig
#
# MUIC devices
#

comment "MUIC configs"

config USE_MUIC
	bool "Using MUIC device driver"
	depends on I2C
	default n
	help
	  If you say yes here you will get support for
	  the MUIC device driver.

config MUIC_NOTIFIER
	bool "MUIC notifier support"
	depends on USE_MUIC
	default n
	help
	  If you say yes here you will get support for
	  the MUIC attached device status change notification.

config MUIC_DOCK_NOTIFIER
	bool "MUIC dock notifier support"
	depends on USE_MUIC
	default y
	help
	  If you say yes here you will get support for
	  the MUIC deskdock attached device status change notification.
	  additional drivers must be disable to stop notification.

config MUIC_RUSTPROOF_ON_USER
	bool "Using MUIC chip Rustproof function ON for User binary"
	depends on USE_MUIC
	default n
	help
	  This feature is for MUIC chip's Rustproof function.

config UART3
        bool "UART3"
        default n
        help
          If you say yes, you can use xo shutdown

config MUIC_SUPPORT_RUSTPROOF
	bool "MUIC Disable UART"
	depends on !SEC_FACTORY
	default n
	help
	 This option will disable the UART to prevent the rusting of the
	 IF Connector in the case of Kmini Devices.
```

## drivers/muic/universal/Kconfig
```kconfig
#
# MUIC devices
#

comment "MUIC configs"

config MUIC_UNIVERSAL
  bool "UNIVERSAL MUIC"
	depends on USE_MUIC
	default n
	help
	  If you say yes here you will get support for various MUIC chips.

config MUIC_UNIVERSAL_SM5708
	bool "SM5708 MUIC"
	depends on USE_MUIC
	default n
	help
	  If you say yes here you will get support for the SM5708 MUIC chip.

config MUIC_PINCTRL
  bool "MUIC PINCTRL"
	depends on USE_MUIC
	default n
	help
	  If you say yes here you will get support for the Pinctrl in MUIC driver.

config MUIC_SUPPORT_RUSTPROOF
	bool "MUIC Disable UART"
	depends on !SEC_FACTORY
	default n
	help
	 This option will disable the UART to prevent the rusting of the
	 IF Connector in the case of Kmini Devices.
```

## drivers/sensors/Kconfig
```kconfig
menu "Sensors"

config SENSORS_CORE
    bool "Sensors Class Support"
    help
      This option enables the sensor sysfs class in /sys/class/sensors.
      You'll need this to do anything useful with sensorss. If unsure, say N.

config SENSORS_CM36657
	depends on I2C
	tristate "CM36657 driver"
	default n
	help
	  This option enables proximity & light sensor using CM36658 driver.

config SENSORS_CM36658
	depends on I2C
	tristate "CM36658 driver"
	default n
	help
	  This option enables proximity & light sensor using CM36658 driver.

config SENSORS_YAS539
	tristate "YAS539 Sensor Driver"
	depends on I2C
	default n
	help
	  If you say yes here you get support for YAMAHA
	  YAS539 Geomagnitor Sensor.

config SENSORS_YAS_RESET_DEFENCE_CODE
	depends on I2C
	tristate "YAS defence code by reset"
	default n
	help
	  This option enables defence code by reset using yas driver.

config SENSORS_YAS539_DEFAULT_MATRIX
	depends on SENSORS_YAS539
	tristate "The default conpensation matrix for YAS539 softiron"
	default n
	help
	  This option is enables the default matrix for YAS539.

config SENSORS_LSM6DSL
	tristate "STMicroelectronics LSM6DSL sensor"
	depends on (I2C || SPI) && SYSFS
	default n
	help
	   This driver support the STMicroelectronics LSM6DSL sensor.
	   To compile this driver as a module, choose M here. The module
	   will be called lsm6dsl.

config SENSORS_LSM6DSL_I2C
	tristate "STMicroelectronics LSM6DSL sensor"
	depends on (I2C || SPI) && SYSFS
	default n
	help
	   This config define sensor communication type is I2C.

config SENSORS_A96T3X6
	depends on I2C
	tristate "A96T3X6 driver for grip"
	default n
	help
	  Say Y here if you use A96T3X6 for grip.
	  This option enables grip sensors using
	  Above A96T3X6 device driver for grip.
	  Say N here if you do not use A96T3X6 for grip.

endmenu
```
